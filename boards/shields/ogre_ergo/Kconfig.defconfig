## boards/shields/ogre_ergo/Kconfig.defconfig
```kconfig
if SHIELD_OGRE_ERGO_LEFT

config ZMK_KEYBOARD_NAME
    default "Ogre Ergo"

config ZMK_SPLIT_ROLE_CENTRAL
    default y

endif

if SHIELD_OGRE_ERGO_RIGHT

config ZMK_KEYBOARD_NAME
    default "Ogre Ergo"

endif

if SHIELD_OGRE_ERGO_LEFT || SHIELD_OGRE_ERGO_RIGHT

config ZMK_SPLIT
    default y

endif
```

## boards/shields/ogre_ergo/Kconfig.shield
```kconfig
config SHIELD_OGRE_ERGO_LEFT
    def_bool $(shields_list_contains,ogre_ergo_left)

config SHIELD_OGRE_ERGO_RIGHT
    def_bool $(shields_list_contains,ogre_ergo_right)
```
